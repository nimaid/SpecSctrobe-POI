#include <avr/pgmspace.h>
#define FHT_N 256
#define LIN_OUT 1
#include <FHT.h>
#include <Adafruit_NeoPixel.h>

//
// Spectrum analyzer
// Pete Reiter
// Spectrum analyzer with a Adafruit neopixel strip as output. Unlike an ordinary 2-dimensional spectrum
// analyzer that uses Y-axis is display intensity of each frequency band, this uses color and brightness of
// the LEDs to indicate the intensity. This code was originally adapted from the PICCOLO tiny music visualizer
// on the Adafruit web site.
// 
// Software requirements:
// - FHT library for Arduino
// - Adafruit Neopixel library.

#define PIN 6 // digital pin for programming neopixels
#define BRIGHT_PIN A1
#define NUM_PIXELS 16 // this is the size of my neopixel strip
#define SPACING_FACTOR 2.0 //Used to make bass larger.
//#define RMS_FACTOR 4.0 //use 2 for RMS, 3, for RMC, etc. Higher makes each channel more sensitive to single freqencies
#define GAIN_FACTOR 3 //higher means lower output values, a >> operation
#define OFF_THRESH 8 //higher clips lower amplitudes

Adafruit_NeoPixel strip = Adafruit_NeoPixel(NUM_PIXELS, PIN, NEO_GRB + NEO_KHZ800);

// Microphone connects to Analog Pin 0.  Corresponding ADC channel number
// varies among boards...it's ADC0 on Uno and Mega, ADC7 on Leonardo.
// Other boards may require different settings; refer to datasheet.
#ifdef __AVR_ATmega32U4__
 #define ADC_CHANNEL 7
#else
 #define ADC_CHANNEL 0
#endif

volatile uint32_t samplePos = 0;     // Buffer position counter

static const uint8_t PROGMEM
  // This is low-level noise that's subtracted from each FHT output column
  // This was experimentally determined in a quiet room.
  noise[128]={ 
    50, 12, 10, 8, 7, 6, 6, 5, // 0
    5, 5, 4, 4, 4, 4, 4, 4,    // 8
    4, 4, 4, 4, 4, 4, 4, 4,    // 16
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    3, 3, 3, 3, 3, 3, 3, 3     // 120
};

static const uint8_t PROGMEM
  calibration[128] = {
    1, 1, 1, 1, 1, 1, 1, 1, 
    1, 1, 1, 1, 1, 1, 1, 1, 
    1, 1, 1, 1, 1, 1, 1, 1, 
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    3, 3, 3, 3, 3, 3, 3, 3  
  } ;

// This is the mapping from the values in the buckets to the colors representing those values. These numbers were generated by some C code that I've pasted into the bottom of this
// file. The colors go from off->blue->green->red with an increase in intensity as the values increase. There's also a log10 based response curve figured in.
#define NUM_COLORS 256
static const uint32_t PROGMEM colors[NUM_COLORS] = { 
0x0, 0x17, 0x2b, 0x3d, 0x4d, 0x5c, 0x55f, 0xc5c, 0x1458, 0x1b55, 0x2252, 0x294f,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 0xff0100
}; 

#define THRESHOLD 1

int num_bins = (FHT_N/2) - 2;
int bins_per_group[NUM_PIXELS];

void setup() {
  Serial.begin(9600);  // set up Serial library at 9600 bps for debugging purposes
  
  //calc number of bins for each group
  float weights[NUM_PIXELS];
  for(int g = 0; g < NUM_PIXELS; g++)
  {
    //calc bins per group weight
    weights[g] = pow((float)g, SPACING_FACTOR) + 1;
  }
  float weight_sum = 0;
  for(int g = 0; g < NUM_PIXELS; g++)
  {
    //Serial.print(weights[g]);
    //Serial.print(' ');
    weight_sum += weights[g];
    //Serial.print(weight_sum);
    //Serial.print(' ');
  }
  //Serial.print('\n');
  //Serial.println(weight_sum);
  for(int g = 0; g < NUM_PIXELS; g++)
  {
    float percent = weights[g] / weight_sum;
    //Serial.print(percent * 100.0);
    //Serial.print(' ');
    float bins = (float)num_bins * percent;
    //Serial.print(bins);
    //Serial.print(' ');
    bins = round(bins);
    if((int)bins > 0)
    {
      bins_per_group[g] = (int)bins;
    }
    else
    {
      bins_per_group[g] = 1;
    }
    Serial.print(bins_per_group[g]);
    Serial.print(' ');
  }
  Serial.print('\n');
  
  pinMode(BRIGHT_PIN, INPUT);
  
  
  // The prescaler settings determine the frequency of audio sampling. We can sample higher
  // frequencies with a lower prescaler value, but it will also raise the lowest frequency that
  // we can sample.
  
  // Init ADC free-run mode; f = ( 16MHz/prescaler ) / 13 cycles/conversion 
  ADMUX  = ADC_CHANNEL; // Channel sel, right-adj, use AREF pin
  ADCSRA = _BV(ADEN)  | // ADC enable
           _BV(ADSC)  | // ADC start
           _BV(ADATE) | // Auto trigger
           _BV(ADIE)  | // Interrupt enable
           // select the prescaler value. Note that the max frequency our FFT will
           // display is half the sample rate.
//           _BV(ADPS2) | _BV(ADPS0); // 32:1 / 13 = 38,460 Hz
//           _BV(ADPS2) | _BV(ADPS1); // 64:1 / 13 = 19,230 Hz
           _BV(ADPS2) | _BV(ADPS1) | _BV(ADPS0); // 128:1 / 13 = 9615 Hz
  ADCSRB = 0;                // Free run mode, no high MUX bit
  DIDR0  = 1 << ADC_CHANNEL; // Turn off digital input for ADC pin
  TIMSK0 = 0;                // Timer0 off

  // Neopixels setup
  // Initialize all pixels to 'off'
  strip.setBrightness(255);
  strip.begin(); // Initialize all pixels to 'off'
  cli();         // disable interrupts when writing neopixels   
  strip.show();
  sei();         // Enable interrupts
  

}

void loop() {
  uint16_t  x, L;
  while(ADCSRA & _BV(ADIE)); // Wait for audio sampling to finish

  fht_window();
  fht_reorder();
  fht_run();
  fht_mag_lin();
  samplePos = 0;                   // Reset sample counter
  ADCSRA |= _BV(ADIE);             // Resume sampling interrupt

  
  // Remove noise
  for(x=0; x<FHT_N/2; x++) {
    L = (pgm_read_byte(&noise[x]) << 6);
    fht_lin_out[x] = (fht_lin_out[x] <= L) ? 0 : (fht_lin_out[x] - L);
  }
  
  
  int bin = 0;
  for (int i = 0; i < strip.numPixels(); i++)
  {
      // We will throw away first 2 regardless (garbage data TBH), so we will use 126, or index 2 to index 127
      // We will lose some bins in the high end as well.
      // We use RMS instead of mean because higher frequencies are more squished together
      float  mean_square = 0;
      for (int j = 0; j < bins_per_group[i]; j++)
      {
        mean_square += (pow(fht_lin_out[bin + 2], 2.0) - mean_square) / (i + 1);
        if(bin + 2 < num_bins)
        {
          bin ++;
        }
      }
      int value = round(sqrt(mean_square));

      value >>= GAIN_FACTOR;
      if (value < OFF_THRESH)
        value = 0;
      if (value >= NUM_COLORS)
        value = NUM_COLORS - 1;      
      strip.setPixelColor(i, pgm_read_dword(&colors[value]));
  }
  cli();        // no interrupts while writing the neopixels
  //strip.setBrightness(analogRead(BRIGHT_PIN));
  strip.show();
  sei();        // restore interrupts
}

// interrupt service routine. This gets called each time the ADC finishes 1 sample.
ISR(ADC_vect) { // Audio-sampling interrupt
  // shift the unsigned input to be centered around 0. The 10-bit ADC is 
  // capable of producing values from 0 - 1023, but with a microphone that outputs
  // 2V max and a reference voltage of 3.3V we will never hit the max.
  fht_input[samplePos] = (ADC - 512) << 6;
//  Serial.println(fht_input[samplePos]);
  if(++samplePos >= FHT_N) ADCSRA &= ~_BV(ADIE); // Buffer full, interrupt off
}

/*
// Some C code I used to generate the values->colors map. I didn't run this code on the Arduino. I used ideone.com
// and then pasted the output into my arduino code.
#include <iostream>
#include <stdint.h>
#include <math.h>
using namespace std;
  
const int numValues = 256; // number of colors in our output array. This should correspond 
                          // to the max value you want to display.

double breakPoint = log10(numValues)/3.0;
//double breakPoint = numValues/4.0;
//
// Blend two colors together based on the ratio. ratio of 0.0 will be 100% color a and
// ratio of 1.0 will be 100% color b.
uint32_t blend (uint32_t ina, uint32_t inb, double ratio)
{
  int r = (((ina >> 16) & 0xff) * (1.0-ratio)) + (((inb >> 16) & 0xff) * ratio);
  int g = (((ina >> 8) & 0xff) * (1.0-ratio)) + (((inb >> 8) & 0xff) * ratio);
  int b = (((ina >> 0) & 0xff) * (1.0-ratio)) + (((inb >> 0) & 0xff) * ratio);
  return ((r << 16) | (g << 8) | b);
}
//
// Scale the intensity of the passed in color. I am using max brightness colors and 
// 0.0 - 1.0 as the scale value.
uint32_t scale (uint32_t ina, double scale_value)
{
  int r = ((ina >> 16) & 0xff) * scale_value;
  int g = ((ina >> 8) & 0xff) * scale_value;
  int b = ((ina >> 0) & 0xff) * scale_value;
  return ((r << 16) | (g << 8) | b);  
}
//  
// Fade off -> blue -> green -> red. I've built in a logarithmic response to make it more of a
// dB meter.
int main() { 
  for (int i = 1; i <= numValues; i++)
  {
    double logValue = log10(i);
    double scaleValue = log10(i+2) / log10(numValues+2);
    //double logValue = i;
    //double scaleValue = i+2 / numValues+2;
    double ratio = (logValue < breakPoint) ? logValue / breakPoint : (logValue - breakPoint) / breakPoint;
    uint32_t color = 0;
    if (logValue < breakPoint)
      color = blend (0x000000, 0x00ff, ratio);
    else if (logValue < breakPoint * 2)
      color = blend (0x0000ff, 0x00ff00, ratio);
    else
      color = blend (0x00ff00, 0xff0000, ratio);
    color = scale (color, scaleValue);
    cout <<  "0x" << hex << color << ", ";
  }
  return 0; 
}
*/